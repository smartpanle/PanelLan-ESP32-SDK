## components/panellan_bsp/Kconfig.projbuild
```kconfig
menu "PanelLan config"

menu "Hardware"

choice EXAMPLE_LCD_INTERFACE
    prompt "LCD board product"
    help
        Select the LCD board product. Prefer configuring with:
          idf.py -DBOARD=<target-dir> set-target <chip> reconfigure
        so SDKCONFIG_DEFAULTS picks components/panellan_bsp/target/<BOARD>/.

        Board choice only picks the product (pins / defaults).
        LCD bus, panel IC and touch drivers are NOT forced here — each board's
        sdkconfig.defaults pre-enables the usual set; change them freely under
        "PanelLan config → LCD / Touch" in menuconfig (or enable extras for experiments).

    config ZX2D10GE01R
        bool "ZX2D10GE01R: RGB565 Interface (480x480, Encoder)"
        depends on IDF_TARGET_ESP32S3
        help
            RGB565 interface for high-resolution displays.
            Resolution: 480*480
            Input: Encoder
            Default drivers (sdkconfig.defaults): RGB + RGB_ONLY.
            Only available on ESP32-S3.

    config ZX2D80CE02S
        bool "ZX2D80CE02S: 8080 Interface (240x320, Touch)"
        depends on IDF_TARGET_ESP32S3
        help
            I80 interface.
            Resolution: 240*320
            Input: Touch
            Default drivers: I80 + ST7789 + FT5x06.
            Only available on ESP32-S3.

    config ZX3D50CE02S_USRC
        bool "ZX3D50CE02S_USRC: I80 Interface (320x480, Touch)"
        depends on IDF_TARGET_ESP32S3
        help
            I80 ST7796.
            Resolution: 320*480
            Input: Touch panel
            Default drivers: I80 + ST7796 + FT5x06.
            Only available on ESP32-S3.

    config ZX3D95CE01S_TR
        bool "ZX3D95CE01S_TR: RGB565 Interface (480x480, Touch)"
        depends on IDF_TARGET_ESP32S3
        help
            RGB565 interface for high-resolution displays.
            Resolution: 480*480
            Input: Touch panel
            Default drivers: RGB + RGB_ONLY + FT5x06.
            Only available on ESP32-S3.

    config ZX4D30NE01S_UR
        bool "ZX4D30NE01S_UR: RGB565 Interface (480x272, No Touch)"
        depends on IDF_TARGET_ESP32S3
        help
            RGB565 interface for high-resolution displays.
            Resolution: 480*272
            Default drivers: RGB + RGB_ONLY (no touch).
            Only available on ESP32-S3.

    config ZX4D30CE08S
        bool "ZX4D30CE08S: 8080 Interface (480x272, Touch)"
        depends on IDF_TARGET_ESP32S3
        help
            8080 interface for high-resolution displays.
            Resolution: 480*272
            Default drivers: I80 + NV3041 + CST3240.
            Only available on ESP32-S3.

    config ZX7D00CE01S
        bool "ZX7D00CE01S: RGB565 Interface (800x480, Touch)"
        depends on IDF_TARGET_ESP32S3
        help
            RGB565 interface for high-resolution displays.
            Resolution: 800*480
            Input: Touch panel
            Default drivers: RGB + RGB_ONLY + GT911.
            Only available on ESP32-S3.

endchoice

config PANELLAN_BOARD_USE_ENCODER
    bool "Board has rotary encoder"
    default y if ZX2D10GE01R
    default n
    help
        Compile encoder/knob init path (hw_knob_*).

choice EXAMPLE_DISPLAY_ROTATION
    prompt "Display Rotation"
    default EXAMPLE_DISPLAY_ROTATION_0
    help
        Select the rotation applied to both the LCD panel and the touch controller
        so that LVGL coordinates match the screen orientation.

config EXAMPLE_DISPLAY_ROTATION_0
    bool "Rotate 0 degrees"

config EXAMPLE_DISPLAY_ROTATION_90
    bool "Rotate 90 degrees clockwise"

config EXAMPLE_DISPLAY_ROTATION_180
    bool "Rotate 180 degrees"

config EXAMPLE_DISPLAY_ROTATION_270
    bool "Rotate 270 degrees clockwise"

endchoice

endmenu

rsource "lcd/Kconfig.panellan"
rsource "touch/Kconfig.panellan"

endmenu
```

## components/panellan_bsp/lcd/Kconfig.panellan
```kconfig
# Fragment sourced by panellan_bsp/Kconfig.projbuild under "PanelLan config".
# Not a top-level component Kconfig — keeps options out of "Component config".

menu "LCD"

comment "Leave all buses off for headless (no display). Board defaults pre-enable the usual bus/IC; change freely. Enabling a Panel IC also pulls its Registry package (see panellan_bsp/idf_component.yml)."

# Panel resolution
config PANELLAN_LCD_H_RES
    int "LCD horizontal resolution (pixels)"
    range 1 4096
    default 480 if ZX3D95CE01S_TR
    default 320 if ZX3D50CE02S_USRC
    default 480 if ZX4D30NE01S_UR
    default 480 if ZX4D30CE08S
    default 800 if ZX7D00CE01S
    default 480 if ZX2D10GE01R
    default 240 if ZX2D80CE02S
    default 480
    help
        Native panel width. Board sdkconfig.defaults set this; keep in sync with touch x_max.

config PANELLAN_LCD_V_RES
    int "LCD vertical resolution (pixels)"
    range 1 4096
    default 480 if ZX3D95CE01S_TR
    default 480 if ZX3D50CE02S_USRC
    default 272 if ZX4D30NE01S_UR
    default 272 if ZX4D30CE08S
    default 480 if ZX7D00CE01S
    default 480 if ZX2D10GE01R
    default 320 if ZX2D80CE02S
    default 480
    help
        Native panel height. Keep in sync with board panel timing / touch y_max.

# Bus types
config PANELLAN_LCD_ENABLE_RGB
    bool "Enable RGB LCD bus"
    default n

config PANELLAN_LCD_ENABLE_I80
    bool "Enable Intel 8080 LCD bus"
    default n

config PANELLAN_LCD_ENABLE_SPI_WITH_PSRAM
    bool "Enable SPI LCD (with PSRAM draw buffers)"
    default n

config PANELLAN_LCD_ENABLE_SPI_WITHOUT_PSRAM
    bool "Enable SPI LCD (without PSRAM / partial buffers)"
    default n

config PANELLAN_LCD_ENABLE_QSPI
    bool "Enable QSPI LCD bus"
    default n

config PANELLAN_LCD_ENABLE_MIPI_DSI
    bool "Enable MIPI DSI LCD bus"
    default n
    depends on IDF_TARGET_ESP32P4
    help
        Requires ESP32-P4 and MIPI DSI capable IDF.


# Panel drivers
menu "Panel IC drivers"

config PANELLAN_LCD_PANEL_RGB_ONLY
    bool "RGB passthrough (no IC)"
    default n
    depends on PANELLAN_LCD_ENABLE_RGB
    help
        For RGB bus boards that need no panel IC driver.

config PANELLAN_LCD_PANEL_ST7789
    bool "ST7789"
    default n
    depends on PANELLAN_LCD_ENABLE_I80
    help
        Uses IDF built-in esp_lcd_panel_st7789 (no extra Registry package).

config PANELLAN_LCD_PANEL_ST7796
    bool "ST7796"
    default n
    depends on PANELLAN_LCD_ENABLE_I80
    help
        Auto-adds espressif/esp_lcd_st7796 via Component Manager.

config PANELLAN_LCD_PANEL_NV3041
    bool "NV3041"
    default n
    depends on PANELLAN_LCD_ENABLE_I80
    help
        Auto-adds eric-c-e/esp_lcd_nv3041.

config PANELLAN_LCD_PANEL_ILI9341
    bool "ILI9341"
    default n
    depends on PANELLAN_LCD_ENABLE_SPI_WITH_PSRAM || PANELLAN_LCD_ENABLE_SPI_WITHOUT_PSRAM
    help
        Auto-adds espressif/esp_lcd_ili9341.

config PANELLAN_LCD_PANEL_GC9A01
    bool "GC9A01"
    default n
    depends on PANELLAN_LCD_ENABLE_SPI_WITH_PSRAM || PANELLAN_LCD_ENABLE_SPI_WITHOUT_PSRAM
    help
        Auto-adds espressif/esp_lcd_gc9a01.

config PANELLAN_LCD_PANEL_ST77916
    bool "ST77916 (QSPI)"
    default n
    depends on PANELLAN_LCD_ENABLE_QSPI
    help
        Auto-adds espressif/esp_lcd_st77916.

config PANELLAN_LCD_PANEL_ST7701
    bool "ST7701 (MIPI)"
    default n
    depends on PANELLAN_LCD_ENABLE_MIPI_DSI
    help
        Auto-adds espressif/esp_lcd_st7701 (ESP32-P4).

endmenu

endmenu
```

## components/panellan_bsp/touch/Kconfig.panellan
```kconfig
# Fragment sourced by panellan_bsp/Kconfig.projbuild under "PanelLan config".
# Not a top-level component Kconfig — keeps options out of "Component config".

menu "Touch"

comment "Board defaults pre-enable the usual IC; change freely. Enabling an IC compiles hw_touch_init and pulls its package (see panellan_bsp/idf_component.yml). Leave all off for no-touch boards."

choice PANELLAN_TOUCH_FT_GT_IC
    prompt "FT5x06 / GT1151 touch IC"
    default PANELLAN_TOUCH_FT_GT_NONE
    help
        No payload. Select FT5x06, GT1151, or do not use these two drivers according to the actual hardware.
        Regardless of the MCU model, unselected drivers are explicitly exported as "n" for the component manager to read.
        Select None when using GT911, CST3240, or a touchless device.

config PANELLAN_TOUCH_FT_GT_NONE
    bool "None"

config PANELLAN_TOUCH_FT5X06
    bool "FT5x06"
    help
        espressif/esp_lcd_touch_ft5x06。

config PANELLAN_TOUCH_GT1151
    bool "GT1151"
    help
        espressif/esp_lcd_touch_gt1151。

endchoice

config PANELLAN_TOUCH_GT911
    bool "Touch driver: GT911"
    default n
    help
        Auto-adds espressif/esp_lcd_touch_gt911.

config PANELLAN_TOUCH_CST3240
    bool "Touch driver: CST3240"
    default n
    help
        Local private driver under panellan_bsp/touch/drivers/ (not on Component Registry).

endmenu
```

## sdkconfig.defaults
```kconfig
# PanelLan common defaults (board-agnostic)
# Layered with: sdkconfig.defaults.<target> ; components/panellan_bsp/target/<BOARD>/sdkconfig.defaults

CONFIG_COMPILER_OPTIMIZATION_PERF=y
CONFIG_COMPILER_DISABLE_DEFAULT_ERRORS=y
CONFIG_FREERTOS_HZ=1000

CONFIG_SPIRAM=y
CONFIG_SPIRAM_SPEED_80M=y
CONFIG_SPIRAM_MEMTEST=n

CONFIG_PARTITION_TABLE_CUSTOM=y
CONFIG_PARTITION_TABLE_CUSTOM_FILENAME="partitions.csv"

CONFIG_LV_USE_SYSMON=y
CONFIG_LV_USE_DEMO_WIDGETS=y
CONFIG_LV_USE_DEMO_BENCHMARK=y
CONFIG_LV_BUILD_DEMOS=y
CONFIG_LV_FONT_MONTSERRAT_14=y
CONFIG_LV_FONT_MONTSERRAT_20=y
CONFIG_LV_FONT_MONTSERRAT_24=y
CONFIG_LV_FONT_MONTSERRAT_26=y
```
